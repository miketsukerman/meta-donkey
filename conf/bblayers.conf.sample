## conf/bblayers.conf.sample
```bitbake
# POKY_BBLAYERS_CONF_VERSION is increased each time build/conf/bblayers.conf
# changes incompatibly
POKY_BBLAYERS_CONF_VERSION = "2"

BBPATH = "${TOPDIR}"
BBFILES ?= ""

GEOPHONE_LAYER_DIR = "${@os.path.abspath(os.path.join("${TOPDIR}", os.pardir))}"

BBLAYERS ?= " \
    ${GEOPHONE_LAYER_DIR}/geophone/meta \
    ${GEOPHONE_LAYER_DIR}/geophone/meta-poky \
    ${GEOPHONE_LAYER_DIR}/geophone/meta-openembedded/meta-oe \
    ${GEOPHONE_LAYER_DIR}/geophone/meta-openembedded/meta-multimedia \
    ${GEOPHONE_LAYER_DIR}/geophone/meta-openembedded/meta-networking \
    ${GEOPHONE_LAYER_DIR}/geophone/meta-openembedded/meta-perl \
    ${GEOPHONE_LAYER_DIR}/geophone/meta-openembedded/meta-python \
    ${GEOPHONE_LAYER_DIR}/geophone/meta-openembedded/meta-webserver \
    ${GEOPHONE_LAYER_DIR}/geophone/meta-swupdate \
    ${GEOPHONE_LAYER_DIR}/geophone/meta-raspberrypi \
    ${GEOPHONE_LAYER_DIR}/geophone/meta-donkeycar \
"
```

## conf/layer.conf
```bitbake
# We have a conf and classes directory, append to BBPATH
BBPATH .= ":${LAYERDIR}"

# We have a recipes directory, add to BBFILES
BBFILES += "${LAYERDIR}/recipes*/*/*.bb \
            ${LAYERDIR}/recipes*/*/*.bbappend \ 
            ${LAYERDIR}/recipes*/*/*/*.bbappend \ 
            ${LAYERDIR}/images/*.bb \
            "

BBFILE_COLLECTIONS += "donkeycar"
BBFILE_PATTERN_donkeycar := "^${LAYERDIR}/"
BBFILE_PRIORITY_donkeycar = "20"

LAYERSERIES_COMPAT_donkeycar = "kirkstone"

BBFILES_DYNAMIC += " \
    donkeycar:${LAYERDIR}/dynamic-layers/donkeycar/*/*/*.bb \
    donkeycar:${LAYERDIR}/dynamic-layers/donkeycar/*/*/*.bbappend \
"
```

## conf/local.conf.sample
```bitbake
# Local configuration for meta-rpi images
# Yocto Project 3.1 Poky distribution [dunfell] branch
# This is a sysvinit system

# mask wireguard from meta-openembedded/meta-networking
# use version in meta-jumpnow to support kernels < 5.6
# with wireguard-linux-compat
BBMASK = "meta-networking/recipes-kernel/wireguard"

LICENSE_FLAGS_ACCEPTED = "commercial"

DISTRO_FEATURES = "ext2 opengl usbhost systemd ${DISTRO_FEATURES_LIBC}"

DISTRO_FEATURES:append = "bluez5 bluetooth wifi"

PREFERRED_PROVIDER_jpeg = "libjpeg-turbo"
PREFERRED_PROVIDER_jpeg-native = "libjpeg-turbo-native"

# PREFERRED_PROVIDER_udev = "eudev"
VIRTUAL-RUNTIME_init_manager = "systemd"

MACHINE_FEATURES:remove = "apm"

IMAGE_FSTYPES = "tar.xz ext4 ext4.gz wic"

RPI_USE_U_BOOT = "1"

PREFERRED_PROVIDER_u-boot-fw-utils = "libubootenv"

# Choose the board you are building for
#MACHINE = "raspberrypi"
#MACHINE = "raspberrypi0"
#MACHINE = "raspberrypi0-wifi"
#MACHINE = "raspberrypi2"
#MACHINE = "raspberrypi3"
MACHINE = "raspberrypi4"
#MACHINE = "raspberrypi-cm"
#MACHINE = "raspberrypi-cm3"

# Choices are Image or zImage if NOT using u-boot (no u-boot is the default)
# Choices are uImage or zImage if using u-boot, though if you choose zImage
# with u-boot you will also have to change the boot script boot command
KERNEL_IMAGETYPE = "uImage"

# uncomment for kernels < 5.6
WIREGUARD_COMPAT = "1"

DISABLE_VC4GRAPHICS = "1"
DISABLE_OVERSCAN = "1"
ENABLE_UART = "1"
ENABLE_RPI3_SERIAL_CONSOLE = "1"
SERIAL_CONSOLES = "115200;ttyAMA0"
# SERIAL_CONSOLES_forcevariable = ""
ENABLE_SPI_BUS = "1"
ENABLE_I2C = "1"
KERNEL_MODULE_AUTOLOAD_rpi += "i2c-dev i2c-bcm2708"
VIDEO_CAMERA = "1"

# PREFERRED_VERSION_linux-raspberrypi = "5.19.%"


# DL_DIR = "/src/oe"
# SSTATE_DIR = "/oe6/rpi/sstate-cache"
# TMPDIR = "/oe6/rpi/tmp-dunfell"

DISTRO = "poky"
PACKAGE_CLASSES = "package_rpm"

# i686 or x86_64
SDKMACHINE = "x86_64"

# for no root passwd uncomment the following and comment the two extra user lines
#EXTRA_IMAGE_FEATURES = "debug-tweaks"

# for a root passwd, change 123456789 below to your password
# inherit extrausers

# EXTRA_USERS_PARAMS = "usermod -P '123456789' root; "

USER_CLASSES = "buildstats"
PATCHRESOLVE = "noop"
RM_OLD_IMAGE = "1"
INHERIT += "rm_work"
CONF_VERSION = "2"
```
